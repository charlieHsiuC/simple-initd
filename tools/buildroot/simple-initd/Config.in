## tools/buildroot/simple-initd/Config.in
```kconfig
config BR2_PACKAGE_SIMPLE_INITD
    bool "simple-initd"
    depends on BR2_PACKAGE_HOST_RUSTC_TARGET_ARCH_SUPPORTS
    select BR2_PACKAGE_HOST_RUSTC
    help
        Simple Init deamon
```
